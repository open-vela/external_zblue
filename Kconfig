## Kconfig
```kconfig
# General configuration options

# Copyright (c) 2014-2015 Wind River Systems, Inc.
# SPDX-License-Identifier: Apache-2.0

source "$APPSDIR/external/zblue/subsys/bluetooth/Kconfig"
source "$APPSDIR/external/zblue/subsys/settings/Kconfig"
source "$APPSDIR/external/zblue/port/Kconfig"
```

## port/Kconfig
```kconfig
#
# For a description of the syntax of this configuration file,
# see kconfig-language at https://www.kernel.org/doc/Documentation/kbuild/kconfig-language.txt
#

if BT
	source "$APPSDIR/external/zblue/zblue/port/Kconfig.zephyr"
endif

config ZEPHYR_WORK_QUEUE
	bool "Use zephyr system work queue"
	default y
	help
	  This option enables support for generic system work
	  queue.

if ZEPHYR_WORK_QUEUE

config SHELL_CMD_BUFF_SIZE
	int "Shell command buffer size"
	default 0
	range 0 256
	help
	  Maximum command size in bytes. One byte is reserved for the string
	  terminator character.
config SYSTEM_WORKQUEUE_STACK_SIZE
	int "System workqueue stack size"
	default 4096

config SYSTEM_WORKQUEUE_PRIORITY
	int "System workqueue priority"
	default 110
	help
	  By default, system work queue priority is the lowest cooperative
	  priority. This means that any work handler, once started, won't
	  be preempted by any other thread until finished.

config SYSTEM_WORKQUEUE_NO_YIELD
	bool "Select whether system work queue yields"
	help
	  By default, the system work queue yields between each work item, to
	  prevent other threads from being starved.  Selecting this removes
	  this yield, which may be useful if the work queue thread is
	  cooperative and a sequence of work items is expected to complete
	  without yielding.

endif

config BT_THREAD_NO_PREEM
	bool "Cooperative thread is used"
	default n
	help
	  A cooperative thread remains the current thread until it performs
	  an action that makes it unready.

config NET_BUF
	bool "Network buffer support"
	help
	  This option enables support for generic network protocol
	  buffers.

config POLL
	bool "Async I/O Framework"
	help
	  Asynchronous notification framework. Enable the k_poll() and
	  k_poll_signal_raise() APIs.  The former can wait on multiple events
	  concurrently, which can be either directly triggered or triggered by
	  the availability of some kernel objects (semaphores and fifos).

config NET_L2_BT
  bool "Enable Bluetooth 6Lowpan support"
  help
    Enable Bluetooth driver that send and receives IPv6 packets,
    does header compression on it and writes it to the
    Bluetooth stack via L2CAP channel.

config NET_BUF_RX_COUNT
  int "How many network buffers are allocated for receiving data"
  default 16
  help
    Each data buffer will occupy CONFIG_NET_BUF_DATA_SIZE + smallish
    header (sizeof(struct net_buf)) amount of data.

config NET_BUF_TX_COUNT
  int "How many network buffers are allocated for sending data"
  default 16
  help
    Each data buffer will occupy CONFIG_NET_BUF_DATA_SIZE + smallish
    header (sizeof(struct net_buf)) amount of data.

config NET_BUF_USER_DATA_SIZE
  int "Size of user_data available in every network buffer"
  default 4
  help
    Amount of memory reserved in each network buffer for user data. In
    most cases this can be left as the default value.

config NUM_COOP_PRIORITIES
  int "Number of coop priorities"
  default 103
  help
    Number of cooperative priorities configured in the system.

config BT_UART_ON_DEV_NAME
  string "Device Name of UART Device for Bluetooth"
  default "/dev/ttyBT"
  help
    This option specifies the name of UART device to be used
    for Bluetooth.


config BT_H4_ENABLE
  bool "Enable used with Bluetooth HCI UART"
  depends on BT_HCI_RAW
  help
    Enable used with Bluetooth HCI UART

if BT_H4_ENABLE

config BT_UART_H4_ON_DEV_NAME
  string "Device Name of UART Device for Bluetooth H4"
  default "/dev/ttyS1"
  help
    This option specifies the name of UART device to be used
    for Bluetooth H4.

config BT_UART_H4_TX_STACK_SIZE
  int "Size of TX Thread Stack for Bluetooth H4"
  default 4096
  help
    This option specifies the size of stack to be used
    for Bluetooth H4.

config BT_RX_STACK_SIZE
  int "Size of the receiving thread stack"
  default 4096
  help
    Size of the receiving thread stack. This is the context from
    which all event callbacks to the application occur. The
    default value is sufficient for basic operation, but if the
    application needs to do advanced things in its callbacks that
    require extra stack space, this value can be increased to
    accommodate for that.

config BT_RX_PRIO
  # Hidden option for Co-Operative Rx thread priority
  int
  default 7

endif

config BT_DEBUG_LOG_LEVEL
  int "BT Debug Log Level"
  default 6
  help
    Sets log level for the BT stack.

config BT_NO_DRIVER
  bool "No default HCI driver"
  help
    This is intended for unit tests where no internal driver
    should be selected.

config BT_LIBUSB
  bool "HCI using LIBUSB"
  default n
  help
    Bluetooth HCI driver for communication with USB driver.

config BT_H4
  bool "H:4 UART"
  default n
  help
    Bluetooth H:4 UART driver. Requires hardware flow control
    lines to be available.

config BT_USERCHAN
  bool
  default n
  depends on ARCH_SIM

config BT_HCI_DEVID
  int "Bluetooth Device ID"
  default 0
  depends on BT_USERCHAN
  help
    Attached the local bluetooth device use specific
    Bluetooth HCI number id.

config BT_NATIVE
  bool "HCI over Native"
  default y
  help
    Attach local controller with direct call method.

config BT_NATIVE_THREAD_STACK_SIZE
  int "Bluetooth HCI Driver Thread Stack Size"
  default 768
  depends on BT_NATIVE && !BT_THREAD_NO_PREEM
  help
    None.

config BT_H4_DEBUG
  bool "H:4 Debug"
  default n
  help
    Debug HCI ACL Command information.


config BT_QUIRK_NO_RESET
  bool "The host should never send HCI_Reset"
  default n
  help
    The host should never send HCI_Reset

config BT_TESTER
  bool "Bluetooth Profile Tuning Suite Tester"
  default n
  help
    Bluetooth Profile Tuning Suite Tester.

if BT_TESTER

config UART_PIPE
  bool
  default y

config UART_PIPE_ON_DEV_NAME
  string "Device Name of UART Device for pipe UART"
  default "/dev/ttyS4"
  help
    This option specifies the name of UART device to be used
    for pipe UART.

endif

menuconfig BT_SAMPLE
  tristate "Bluetooth Stack Examples"
  default n
  ---help---
    Enable Bluetooth Stack Examples

if BT_SAMPLE

config BT_MIBLE_TEST
  bool "mible shell commands"
  default n
  depends on BT_SHELL
  help
    Select to use mible shell commands.

config BT_SAMPLE_STACKSIZE
  int "BT sample stack size"
  default 40960 if ARCH_SIM
  default DEFAULT_TASK_STACKSIZE
  help
    Sets log level for the BT stack.

config BT_SAMPLE_PERIPHERAL
  bool "Enable Bluetooth peripheral example"
  default n
  depends on BT_PERIPHERAL
  help
    Enable Bluetooth peripheral example

config BT_SAMPLE_CENTRAL
  bool "Enable Bluetooth central example"
  default n
  depends on BT_CENTRAL
  help
    Enable Bluetooth central example

config BT_SAMPLE_MESH
  bool "Enable Bluetooth mesh example"
  default n
  depends on BT_MESH
  help
    Enable Bluetooth mesh example

endif

config SHELL_STR_SIZE
  int "Shell Command String Size"
  default 32
  help
    Shell Command String Size

config FILE_SYSTEM
  bool "File system support"
  help
    Enables support for file system.

if FILE_SYSTEM

config FILE_SYSTEM_MAX_FILE_NAME
  int "Optional override for maximum file name length"
  default 32
  help
    Specify the maximum file name allowed across all enabled file
    system types.  Zero or a negative value selects the maximum
    file name length for enabled in-tree file systems.  This
    default may be inappropriate when registering an out-of-tree
    file system.  Selecting a value less than the actual length
    supported by a file system may result in memory access
    violations.
endif

config NVS
	bool "Non-volatile Storage"
	help
	  Enable support of Non-volatile Storage.

if NVS

config NVS_PATH
  string "Non-volatile Storage Path"
  depends on NVS
  help
    Enable support of Non-volatile Storage Path.

config NVS_LOOKUP_CACHE
  bool "Non-volatile Storage lookup cache"
  help
    Enable Non-volatile Storage cache, used to reduce the NVS data lookup
    time. Each cache entry holds an address of the most recent allocation
    table entry (ATE) for all NVS IDs that fall into that cache position.

config NVS_LOOKUP_CACHE_SIZE
  int "Non-volatile Storage lookup cache size"
  default 128
  range 1 65536
  depends on NVS_LOOKUP_CACHE
  help
    Number of entries in Non-volatile Storage lookup cache.
    It is recommended that it be a power of 2.

config FLASH_MAP
  int "Flash maps"
  default 1 if NVS
  range 0 8
  help
    Enable support flash maps

if FLASH_MAP > 0

config FLASH_MAP_0_NAME
  string "Flash map 0 name"
  default NVS_PATH

if FLASH_MAP > 1
config FLASH_MAP_1_NAME
  string "Flash map 1 name"
endif # FLASH_MAP > 1

if FLASH_MAP > 2
config FLASH_MAP_2_NAME
  string "Flash map 2 name"
endif # FLASH_MAP > 2

if FLASH_MAP > 3
config FLASH_MAP_3_NAME
  string "Flash map 3 name"
endif # FLASH_MAP > 3

if FLASH_MAP > 4
config FLASH_MAP_4_NAME
  string "Flash map 4 name"
endif # FLASH_MAP > 4

if FLASH_MAP > 5
config FLASH_MAP_5_NAME
  string "Flash map 5 name"
endif # FLASH_MAP > 5

if FLASH_MAP > 6
config FLASH_MAP_6_NAME
  string "Flash map 6 name"
endif # FLASH_MAP > 6

if FLASH_MAP > 7
config FLASH_MAP_7_NAME
  string "Flash map 7 name"
endif # FLASH_MAP > 7

endif # FLASH_MAP > 0

endif # NVS

config ZTEST
  bool "Test zblue subsystem"
  help
    Enables to test zblue subsystem

if ZTEST

config ZTEST_TIMEOUT
  bool "Test zblue kernel timeout"
  help
    Enables to zblue kernel timeout

config ZTEST_WORK_Q
  bool "Test zblue kernel work queue"
  help
    Enables to zblue kernel work queue

config ZTEST_THREAD
  bool "Test zblue kernel thread"
  help
    Enables to zblue kernel thread

config ZTEST_POLL
  bool "Test zblue kernel poll"
  help
    Enables to zblue kernel poll

config ZTEST_QUEUE
  bool "Test zblue kernel queue"
  help
    Enables to zblue kernel queue

config ZTEST_MEMSLAB
  bool "Test zblue kernel mem slab"
  help
    Enables to zblue kernel mem slab

config ZTEST_NVM
  bool "Test NVM"
  depends on SETTINGS_NVS
  help
    Enables to test NVM

endif
```

## port/Kconfig.zephyr
```kconfig
#
# For a description of the syntax of this configuration file,
# see kconfig-language at https://www.kernel.org/doc/Documentation/kbuild/kconfig-language.txt
#

config ASSERT
	bool "Enable zblue assert"
	default y

if ASSERT

config ASSERT_LEVEL
	int "__ASSERT() level"
	default 2
	range 0 2
	help
	  This option specifies the assertion level used by the __ASSERT()
	  macro. It can be set to one of three possible values:

	  Level 0: off
	  Level 1: on + warning in every file that includes __assert.h
	  Level 2: on + no warning

config ASSERT_VERBOSE
	bool "Verbose assertions"
	default y
	help
	  This option enables printing an assert message with information about
	  the assertion that occurred. This includes printing the location,
	  the conditional expression and additional message specific to the
	  assert.

config ASSERT_NO_FILE_INFO
	bool "Disable file info for asserts"
	help
	  This option removes the name and the path of the source file
	  in which the assertion occurred. Enabling this will save
	  target code space, and thus may be necessary for tiny targets.

config ASSERT_NO_COND_INFO
	bool "Disable condition info for asserts"
	help
	  This option removes the assert condition from the printed assert
	  message. Enabling this will save target code space, and thus may be
	  necessary for tiny targets. It is recommended to disable condition
	  info before disabling file info since the condition can be found in
	  the source using file info.

config ASSERT_NO_MSG_INFO
	bool "Disable message for asserts"
	help
	  This option removes the additional message from the printed assert.
	  Enabling this will save target code space, and thus may be
	  necessary for tiny targets. It is recommended to disable message
	  before disabling file info since the message can be found in the
	  source using file info.

endif

config PM_DEVICE
	int
	default 0

config NET_BUF_WARN_ALLOC_INTERVAL
	int
	default 0

config ATOMIC_OPERATIONS_C
	bool
	default y

config SRAM_BASE_ADDRESS
	int
	default 0

config NUM_METAIRQ_PRIORITIES
	int
	default 0

config NUM_PREEMPT_PRIORITIES
	int
	default 0

config HEAP_MEM_POOL_SIZE
	int
	default 0

config NUM_MBOX_ASYNC_MSGS
	int
	default 0

config MP_NUM_CPUS
	int
	default 0

config LOG_SPEED
	int
	default 0

config LOG2_MODE_IMMEDIATE
	int
	default 0

config LOG2_ALWAYS_RUNTIME
	int
	default 0

config LOG2_USE_VLA
	int
	default 0

config LOG_TRACE_SHORT_TIMESTAMP
	int
	default 0

config LOG_TIMESTAMP_64BIT
	int
	default 0

config SYS_CLOCK_HW_CYCLES_PER_SEC
	int
	default -1

config SYS_CLOCK_EXISTS
	bool
	default y

config SYS_CLOCK_MAX_TIMEOUT_DAYS
	int
	default 365
```
