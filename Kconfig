## subsys/bluetooth/audio/Kconfig
```kconfig
# Bluetooth Audio configuration options

#
# Copyright (c) 2020 Intel Corporation
# Copyright (c) 2022 Nordic Semiconductor ASA
#
# SPDX-License-Identifier: Apache-2.0
#

menuconfig BT_AUDIO
	bool "Bluetooth Audio support"
	help
	  This option enables Bluetooth Audio support. The specific
	  features that are available may depend on other features
	  that have been enabled in the stack, such as Periodic
	  Advertisement for Broadcast and L2CAP Dynamic Channel
	  for Unicast.

if BT_AUDIO

config BT_AUDIO_RX
	bool
	help
	  This hidden option is enabled when any of the profiles/services
	  enables support for receiving of audio data.

config BT_AUDIO_TX
	bool
	help
	  This hidden option is enabled when any of the profiles/services
	  enables support for transmitting of audio data.

config BT_AUDIO_NOTIFY_RETRY_DELAY
	int "Delay for notification sending retried attempt in 1.25 ms units"
	range 6 3200
	default 20
	help
	  This option sets the time in 1.25 ms units before the stack will
	  retry to send notification that failed due to lack of TX buffers
	  available.

source "$APPSDIR/external/zblue/zblue/subsys/bluetooth/audio/Kconfig.bap"
source "$APPSDIR/external/zblue/zblue/subsys/bluetooth/audio/Kconfig.vocs"
source "$APPSDIR/external/zblue/zblue/subsys/bluetooth/audio/Kconfig.aics"
source "$APPSDIR/external/zblue/zblue/subsys/bluetooth/audio/Kconfig.vcp"
source "$APPSDIR/external/zblue/zblue/subsys/bluetooth/audio/Kconfig.micp"
source "$APPSDIR/external/zblue/zblue/subsys/bluetooth/audio/Kconfig.csip"
source "$APPSDIR/external/zblue/zblue/subsys/bluetooth/audio/Kconfig.tbs"
source "$APPSDIR/external/zblue/zblue/subsys/bluetooth/audio/Kconfig.mcs"
source "$APPSDIR/external/zblue/zblue/subsys/bluetooth/audio/Kconfig.has"
source "$APPSDIR/external/zblue/zblue/subsys/bluetooth/audio/Kconfig.mpl"
source "$APPSDIR/external/zblue/zblue/subsys/bluetooth/audio/Kconfig.mctl"
source "$APPSDIR/external/zblue/zblue/subsys/bluetooth/audio/Kconfig.cap"
source "$APPSDIR/external/zblue/zblue/subsys/bluetooth/audio/Kconfig.tmap"
source "$APPSDIR/external/zblue/zblue/subsys/bluetooth/audio/Kconfig.gmap"
source "$APPSDIR/external/zblue/zblue/subsys/bluetooth/audio/Kconfig.pbp"

module = BT_AUDIO
module-str = "Bluetooth Audio"
# source "$APPSDIR/external/zblue/zblue/subsys/logging/Kconfig.template.log_config"

endif # BT_AUDIO
```

## subsys/bluetooth/services/Kconfig
```kconfig
# GATT Services

# Copyright (c) 2018 Nordic Semiconductor ASA
# SPDX-License-Identifier: Apache-2.0

menu "GATT Services"
	depends on BT_CONN

source "$APPSDIR/external/zblue/zblue/subsys/bluetooth/services/Kconfig.dis"

source "$APPSDIR/external/zblue/zblue/subsys/bluetooth/services/Kconfig.cts"

source "$APPSDIR/external/zblue/zblue/subsys/bluetooth/services/Kconfig.hrs"

source "$APPSDIR/external/zblue/zblue/subsys/bluetooth/services/Kconfig.tps"

source "$APPSDIR/external/zblue/zblue/subsys/bluetooth/services/nus/Kconfig.nus"

source "$APPSDIR/external/zblue/zblue/subsys/bluetooth/services/ias/Kconfig.ias"

source "$APPSDIR/external/zblue/zblue/subsys/bluetooth/services/ots/Kconfig"

source "$APPSDIR/external/zblue/zblue/subsys/bluetooth/services/bas/Kconfig.bas"

endmenu
```
